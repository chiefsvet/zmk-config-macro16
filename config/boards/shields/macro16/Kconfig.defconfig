## config/boards/shields/macro16/Kconfig.defconfig
```kconfig
if SHIELD_MACRO16

config ZMK_KEYBOARD_NAME
    default "macro16"

config BT_CTLR
    default BT

config ZMK_BLE
    default y
    
endif
```

## config/boards/shields/macro16/Kconfig.shield
```kconfig
config SHIELD_MACRO16
    def_bool $(shields_list_contains,macro16)

config BOARD_ENABLE_DCDC
    bool "Enable DCDC mode"
    select SOC_DCDC_NRF52X
    default y
    depends on macro16
```
